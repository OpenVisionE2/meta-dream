## conf/machine/dm500hd.conf
```bitbake
#@TYPE: Machine
#@NAME: Dreambox DM500HD
#@DESCRIPTION: Machine configuration for the Dreambox DM500HD

MACHINE_FEATURES += "fan modem dvb-c blindscan-dvbc hdmicec smallflash usbconsole"

require conf/machine/include/dreambox-brcmnand.inc
require conf/machine/include/dreambox-nand-64mb.inc
require conf/machine/include/dreambox-part-64mb.inc
require conf/machine/include/dreambox-jffs2.inc
require conf/machine/include/dreambox-mips32el.inc

PREFERRED_VERSION_linux-dreambox = "3.2"

CHIPSET = "bcm7405"

# Image fails to boot if kernel exceeds some unknown limit, so make that
# explicit here. I don't know what the actual limit is, but 6416679 boots
# and 6604470 didn't.
KERNEL_IMAGE_MAXSIZE = "6500000"
```

## conf/machine/dm7080.conf
```bitbake
#@TYPE: Machine
#@NAME: Dreambox DM7080
#@DESCRIPTION: Machine configuration for the Dreambox DM7080

MACHINE_FEATURES += "modem kernelwifi externalwifi dvb-c blindscan-dvbc hdmicec recovery ci dvd usbconsole colorlcd128 grautec"

CHIPSET = "bcm7435"

require conf/machine/include/dreambox-mips32el.inc
require conf/machine/include/dreambox-mips32el-new.inc

MTD_BLACK  = "mmcblk0"
```

## conf/machine/dm800.conf
```bitbake
#@TYPE: Machine
#@NAME: Dreambox DM 800 HD PVR
#@DESCRIPTION: Machine configuration for the Dreambox DM 800 HD PVR

MACHINE_FEATURES += "modem dvb-c blindscan-dvbc smallflash usbconsole oldkernel olde2api"

MACHINE_ESSENTIAL_EXTRA_RDEPENDS += "dm-bootsplash dm-shutdown dm-startupfix"

require conf/machine/include/dreambox-brcmnand.inc
require conf/machine/include/dreambox-nand-64mb.inc
require conf/machine/include/dreambox-part-64mb.inc
require conf/machine/include/dreambox-jffs2.inc
require conf/machine/include/dreambox-mips32el-nf.inc

CHIPSET = "bcm7401"
DVBPROVIDER = "v4l-dvb"

# Image fails to boot if kernel exceeds some unknown limit, so make that
# explicit here. I don't know what the actual limit is, but 6416679 boots
# and 6604470 didn't.
KERNEL_IMAGE_MAXSIZE = "6500000"
```

## conf/machine/dm8000.conf
```bitbake
#@TYPE: Machine
#@NAME: Dreambox DM8000
#@DESCRIPTION: Machine configuration for the Dreambox DM8000

MACHINE_FEATURES += "pci kernelwifi externalwifi dvb-c blindscan-dvbc frontprocessor ci dvd colorlcd128 grautec smallflash"

MACHINE_ESSENTIAL_EXTRA_RDEPENDS += "dm-bootsplash"

require conf/machine/include/dreambox-nand-256mb.inc
require conf/machine/include/dreambox-part-256mb.inc
require conf/machine/include/dreambox-ubi.inc
require conf/machine/include/dreambox-mips32el.inc

PREFERRED_VERSION_linux-dreambox = "3.2"

CHIPSET = "bcm7400"

MACHINE_EXTRA_RRECOMMENDS += "dreambox-enigma2-config"
```

## conf/machine/dm820.conf
```bitbake
#@TYPE: Machine
#@NAME: Dreambox DM820
#@DESCRIPTION: Machine configuration for the Dreambox DM820

MACHINE_FEATURES += "modem kernelwifi externalwifi dvb-c blindscan-dvbc hdmicec recovery ci dvd usbconsole colorlcd bwlcd96"

CHIPSET = "bcm7435"

require conf/machine/include/dreambox-mips32el.inc
require conf/machine/include/dreambox-mips32el-new.inc

MTD_BLACK  = "mmcblk0"
```

## conf/machine/dm900.conf
```bitbake
#@TYPE: Machine
#@NAME: Dreambox DM900
#@DESCRIPTION: Machine configuration for the Dreambox DM900

MACHINE_FEATURES += "modem kernelwifi dvb-c blindscan-dvbc hdmicec recovery ci dvd usbconsole colorlcd390 blindscan-tbs"

CHIPSET = "bcm7252s"
SOC_FAMILY = "bcm7252s"

require conf/machine/include/dreambox-arm.inc
```

## conf/machine/include/dreambox-mips32el-new.inc
```bitbake
# dreambox-mips32el-new.inc

BOX_BRAND = "dreambox"

PREFERRED_PROVIDER_virtual/libgl ?= "mesa-gl"
PREFERRED_PROVIDER_virtual/mesa ?= "mesa-gl"
PREFERRED_VERSION_linux-dreambox = "3.4"

DISTRO_FEATURES_GFX_mipsel ?= " opengl"

PACKAGECONFIG_pn-glmark2 = "gles2"

PACKAGECONFIG_pn-cogl-1.0 = "egl-kms egl-null \
        ${@bb.utils.contains('DISTRO_FEATURES', 'opengl', 'gles2', '', d)}"

PACKAGECONFIG_pn-weston = "${@bb.utils.contains('DISTRO_FEATURES', 'opengl', 'gles', '', d)}"

MACHINE_EXTRA_RRECOMMENDS += "\
    gstreamer1.0-libav \
    "

DREAMBOX_IMAGE_SIZE ??= "1024"

IMAGE_FSTYPES =+ "tar.xz"

IMAGE_CMD_tar_prepend = "\
    mkdir -p ${IMAGE_ROOTFS}/tmp; \
    mkdir -p ${IMAGE_ROOTFS}/var/lib/opkg/info; \
    echo "#!/bin/sh" > ${IMAGE_ROOTFS}/var/lib/opkg/info/dreambox-secondstage.postinst; \
    echo "[ -n \"$D\" ] || flash-ssbl /usr/share/dreambox-secondstage/ssbl.bin" >> ${IMAGE_ROOTFS}/var/lib/opkg/info/dreambox-secondstage.postinst; \
    chmod 777 ${IMAGE_ROOTFS}/var/lib/opkg/info/dreambox-secondstage.postinst; \
    rm -f ${DEPLOY_DIR_IMAGE}/.tar.xz; \
    "

IMAGE_CMD_tar_append = ";\
    cd ${DEPLOY_DIR_IMAGE}; \
    rm -f *.rootfs.manifest; \
    rm -f .manifest; \
    "
```

## conf/machine/include/dreambox-mips32el-nf.inc
```bitbake
# dreambox-mips32el-nf.inc

BOX_BRAND = "dreambox"

TARGET_ARCH = "mipsel"
DEFAULTTUNE = "mips32el-nf"

MTD_KERNEL = "mtd2"

KERNEL_FILE = "kernel.bin"
ROOTFS_FILE = "rootfs.bin"

MACHINE_FEATURES_BACKFILL_CONSIDERED = "rtc"
OPTIONAL_BSP_PACKAGES += "dreambox-buildimage"
EXTRA_IMAGEDEPENDS += "dreambox-secondstage-${MACHINE}"
MACHINE_ESSENTIAL_EXTRA_RDEPENDS ?= ""

MACHINE_ESSENTIAL_EXTRA_RDEPENDS += "\
	dreambox-dvb-modules-${MACHINE}	\
	v4l-dvb-module-dvb-core	\
	v4l-dvb-module-stv0299 \
	firmware-rt73 \
	firmware-rtl8712u \
	firmware-zd1211 \
	\
	rtl871x \
	rt73 \
	kernel-module-zd1211rw \
"

KERNEL_MODULE_AUTOLOAD += "xfs"

MACHINE_EXTRA_RRECOMMENDS += "\
	gstreamer1.0-plugin-dvbmediasink \
	ntfs-3g \
	kernel-module-cifs \
	kernel-module-hmac \
	kernel-module-md4 \
	kernel-module-ecb \
	dreambox-boot-progress \
	"

GLIBC_EXTRA_OECONF = "--with-tls --with-__thread"
DVBMEDIASINK_CONFIG = "--with-dts=no"
OLDEST_KERNEL = "2.6.18"
GCCVERSION = "9.1.0"
GLIBCVERSION = "2.19"

PREFERRED_VERSION_gcc-cross-initial-${TARGET_ARCH} = ""
PREFERRED_VERSION_rtl8192cu = "3.3.0"
PREFERRED_VERSION_libnl = "3.2.24"
PREFERRED_VERSION_linux-dreambox = "2.6.18"
PREFERRED_VERSION_linux-libc-headers = "2.6.18"
PREFERRED_VERSION_wpa-supplicant = "0.5.8"
PREFERRED_VERSION_wscan = "20130331"
PREFERRED_VERSION_binutils = "2.28"
PREFERRED_VERSION_binutils-native = "2.28"
PREFERRED_VERSION_binutils-cross-${TARGET_ARCH} = "2.28"
PREFERRED_VERSION_binutils-crosssdk-${SDK_ARCH} = "2.28"
PREFERRED_VERSION_binutils-cross-canadian-${TRANSLATED_TARGET_ARCH} = "2.28"

MACHINE_FEATURES += "alsa usbhost 3dtv switchoff dreambox legacykernel"
# Add "dreambox" override for recipes
MACHINEOVERRIDES .= ":dreambox"

PREFERRED_PROVIDER_virtual/bootloader = "dreambox-secondstage-${MACHINE}"
PREFERRED_PROVIDER_virtual/kernel = "linux-dreambox"

PREFERRED_PROVIDER_virtual/blindscan-dvbs = "dreambox-blindscan-utils"
PREFERRED_PROVIDER_virtual/blindscan-dvbc = "dreambox-blindscan-utils"

KERNEL_IMAGETYPE = "vmlinux"
KERNEL_OUTPUT = "${KERNEL_IMAGETYPE}"
KERNEL_OUTPUT_DIR = "."
KERNEL_CONSOLE = "${@bb.utils.contains('MACHINE_FEATURES', 'usbconsole', 'ttyS0,115200', 'null', d)}"

DREAMBOX_BUILDIMAGE = "buildimage --arch ${MACHINE} ${EXTRA_BUILDCMD} \
	--erase-block-size ${DREAMBOX_ERASE_BLOCK_SIZE} \
	--flash-size ${DREAMBOX_FLASH_SIZE} \
	--sector-size ${DREAMBOX_SECTOR_SIZE}"

require conf/machine/include/tune-mips32.inc
```
